/*
 * Copyright (c) 2021 Andes Technology Corporation
 *
 * SPDX-License-Identifier: Apache-2.0
 */

/dts-v1/;

#include <andes/andes_v5_ae350.dtsi>

/ {
	model = "Andes ADP-XC7K AE350";
	compatible = "andestech,adp_xc7k_ae350";

	aliases {
		/*gpio-0 = &gpio0;
		led0 = &seg7_led1_g;
		led1 = &seg7_led2_g;
		sw0 = &user_button1;*/
	};

	chosen {
		zephyr,console = &uart0;
		zephyr,shell-uart = &uart0;
		zephyr,sram = &ram0;
		zephyr,flash = &flash0;
	};

};

&uart0 {
	status = "okay";
	current-speed = <115200>;
};

