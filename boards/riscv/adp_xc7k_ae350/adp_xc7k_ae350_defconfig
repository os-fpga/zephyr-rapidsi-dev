## boards/riscv/adp_xc7k_ae350/adp_xc7k_ae350_defconfig
```kconfig
#CONFIG_SOC_SERIES_RISCV_ANDES_V5=y
CONFIG_SOC_SERIES_RISCV_VIRT=y
CONFIG_SOC_RISCV_VIRT=y

#CONFIG_SOC_RISCV_ANDES_AE350=y
CONFIG_BOARD_ADP_XC7K_AE350=y
CONFIG_XIP=n
CONFIG_PLIC=y
CONFIG_RISCV_MACHINE_TIMER=y
CONFIG_CONSOLE=y
CONFIG_STDOUT_CONSOLE=y
CONFIG_UART_CONSOLE=y
#### JRM ####
CONFIG_SMP=y
CONFIG_MP_NUM_CPUS=2
#CONFIG_MULTITHREADING=y
#CONFIG_RUNTIME_ERROR_CHECKS=y
#CONFIG_SRAM_REGION_PERMISSIONS=y
CONFIG_RAM_CONSOLE=y
CONFIG_STACK_SENTINEL=y
#CONFIG_HW_STACK_PROTECTION=y
CONFIG_RISCV_PMP=y
#CONFIG_ASSERT=n
#CONFIG_FORCE_NO_ASSERT=y
#CONFIG_DEBUG=y
#CONFIG_LOG=y
####### JRM #@#####
#
CONFIG_QEMU_ICOUNT=n
#CONFIG_QEMU_ICOUNT_SHIFT=6

CONFIG_IDLE_STACK_SIZE=1024

#CONFIG_SRAM_SIZE=65536

# Serial driver options
CONFIG_SERIAL=y
CONFIG_UART_NS16550=y

# GPIO driver options
#CONFIG_GPIO=y

# RV64 options
#CONFIG_RV64I_CPU=y

# FPU (single precision) options
#CONFIG_FPU=y
#CONFIG_FPU_SHARING=y
#CONFIG_FLOAT_HARD=y
#CONFIG_SINGLE_PRECISION_FPU=y

# FPU (double precision) options
#CONFIG_FPU=y
#CONFIG_FPU_SHARING=y
#CONFIG_FLOAT_HARD=y
#CONFIG_DOUBLE_PRECISION_FPU=y

# HW DSP options
#CONFIG_SOC_ANDES_V5_HWDSP=y

# Cache options
#CONFIG_CACHE_ENABLE=y

# Nocache memory options
#CONFIG_SOC_ANDES_V5_PMA=y
#CONFIG_NOCACHE_MEMORY=y
#
```

## boards/riscv/andes_v5/Kconfig.board
```kconfig
# Copyright (c) 2021 Andes Technology Corporation
# SPDX-License-Identifier: Apache-2.0

config BOARD_ADP_XC7K_AE350
	bool "Andes ADP-XC7K AE350 Platform"
	depends on SOC_RISCV_ANDES_AE350

config BOARD_VCU118_AE350
	bool "Andes VCU118 AE350 Platform"
	depends on SOC_RISCV_ANDES_AE350
```

## boards/riscv/andes_v5/Kconfig.defconfig
```kconfig
# Copyright (c) 2021 Andes Technology Corporation
# SPDX-License-Identifier: Apache-2.0

config BOARD
	default "adp_xc7k_ae250" if BOARD_ADP_XC7K_AE250
	default "adp_xc7k_ae350" if BOARD_ADP_XC7K_AE350
	default "adp_corvette_f1" if BOARD_ADP_CORVETTE_F1
	default "vcu118_ae350" if BOARD_VCU118_AE350
```

## boards/riscv/andes_v5/adp_xc7k_ae250_defconfig
```kconfig
CONFIG_SOC_SERIES_RISCV_ANDES_V5=y
CONFIG_SOC_RISCV_ANDES_AE250=y
CONFIG_BOARD_ADP_XC7K_AE250=y
CONFIG_XIP=n
CONFIG_PLIC=y
CONFIG_RISCV_MACHINE_TIMER=y
CONFIG_CONSOLE=y
CONFIG_UART_CONSOLE=y
CONFIG_PRINTK=y

# Serial driver options
CONFIG_SERIAL=y
CONFIG_UART_NS16550=y

# GPIO driver options
CONFIG_GPIO=y
CONFIG_GPIO_ANDES_ATCGPIO100=y

CONFIG_COUNTER=y
CONFIG_COUNTER_ANDES_ATCPIT100=y
CONFIG_I2C=y
CONFIG_I2C_ANDES_ATCIIC100=y
CONFIG_SPI=y
CONFIG_SPI_ANDES_ATCSPI200=y
CONFIG_FLASH=y
CONFIG_SPI_NOR=y
CONFIG_BOOT_BANNER=y

# RV64 options
#CONFIG_RISCV_RV64=y

# FPU (single precision) options
#CONFIG_FPU=y
#CONFIG_FPU_SHARING=y
#CONFIG_FLOAT_HARD=y
#CONFIG_SINGLE_PRECISION_FPU=y

# FPU (double precision) options
#CONFIG_FPU=y
#CONFIG_FPU_SHARING=y
#CONFIG_FLOAT_HARD=y
#CONFIG_DOUBLE_PRECISION_FPU=y

# RV32E options
#CONFIG_EMBEDDED_ISA=y

# HW DSP options
#CONFIG_SOC_ANDES_V5_HWDSP=y
```

## boards/riscv/andes_v5/adp_xc7k_ae350_defconfig
```kconfig
CONFIG_SOC_SERIES_RISCV_ANDES_V5=y
CONFIG_SOC_RISCV_ANDES_AE350=y
CONFIG_BOARD_ADP_XC7K_AE350=y
CONFIG_XIP=n
CONFIG_PLIC=y
CONFIG_RISCV_MACHINE_TIMER=y
CONFIG_CONSOLE=y
CONFIG_UART_CONSOLE=y
CONFIG_PRINTK=y

# Serial driver options
CONFIG_SERIAL=y
CONFIG_UART_NS16550=y

# GPIO driver options
CONFIG_GPIO=y
CONFIG_GPIO_ANDES_ATCGPIO100=y

CONFIG_COUNTER=y
CONFIG_COUNTER_ANDES_ATCPIT100=y
CONFIG_I2C=y
CONFIG_I2C_ANDES_ATCIIC100=y
CONFIG_SPI=y
CONFIG_SPI_ANDES_ATCSPI200=y
CONFIG_FLASH=y
CONFIG_SPI_NOR=y
CONFIG_BOOT_BANNER=y
CONFIG_SYSTEM_WORKQUEUE_STACK_SIZE=4096

# RV64 options
#CONFIG_RISCV_RV64=y

# FPU (single precision) options
#CONFIG_FPU=y
#CONFIG_FPU_SHARING=y
#CONFIG_FLOAT_HARD=y
#CONFIG_SINGLE_PRECISION_FPU=y

# FPU (double precision) options
#CONFIG_FPU=y
#CONFIG_FPU_SHARING=y
#CONFIG_FLOAT_HARD=y
#CONFIG_DOUBLE_PRECISION_FPU=y

# HW DSP options
#CONFIG_SOC_ANDES_V5_HWDSP=y

# SMP options
#CONFIG_USE_SWITCH=y
#CONFIG_SMP=y
#CONFIG_MP_NUM_CPUS=$(cores_num)

# Cache options
#CONFIG_CACHE_ENABLE=y

# Nocache memory options
#CONFIG_SOC_ANDES_V5_PMA=y
#CONFIG_NOCACHE_MEMORY=y

# Coherence Manager options
#CONFIG_SOC_ANDES_V5_CM=y

# Ethernet options
#CONFIG_NETWORKING=y
#CONFIG_NET_SOCKETS=y
#CONFIG_NET_L2_ETHERNET=y
#CONFIG_ETH_ANDES_ATFMAC100=y
#CONFIG_NET_DEFAULT_IF_ETHERNET=y

#CONFIG_NET_CONFIG_SETTINGS=y
#CONFIG_DNS_RESOLVER=y
#CONFIG_DNS_SERVER_IP_ADDRESSES=y
#CONFIG_DNS_SERVER1="10.0.1.221"
#CONFIG_NET_CONFIG_MY_IPV4_GW="10.0.12.254"
```

## boards/riscv/rapidsi_glv/Kconfig.board
```kconfig
# Copyright (c) 2021 Andes Technology Corporation
# SPDX-License-Identifier: Apache-2.0

config BOARD_RAPIDSI_GLV
	bool "rapidsi_glv"
	depends on SOC_RISCV_ANDES_AE350
```

## boards/riscv/rapidsi_glv/Kconfig.defconfig
```kconfig
# Copyright (c) 2021 Andes Technology Corporation
# SPDX-License-Identifier: Apache-2.0

config BOARD
	default "rapidsi_glv" if BOARD_RAPIDSI_GLV
```

## drivers/counter/Kconfig.andes_atcpit100
```kconfig
# Kconfig Andes ATCPIT100 configuration option
#
# Copyright (c) 2019 Andes Technology Corporation.
#
# SPDX-License-Identifier: Apache-2.0

menuconfig COUNTER_ANDES_ATCPIT100
	bool "Andes ATCPIT100 PIT driver"
	depends on SOC_SERIES_RISCV_ANDES_V5
	help
	  Enable driver for the Andes ATCPIT100 PIT controller.

	  Says n if not sure.
```

## drivers/display/Kconfig.andes_atflcdc100
```kconfig
# Kconfig Andes ATCSPI200 SPI configuration options
#
# Copyright (c) 2019 Andes Technology Corporation.
#
# SPDX-License-Identifier: Apache-2.0
#

menuconfig DISPLAY_ANDES_ATFLCDC100
	bool "Andes ATFLCDC100 display driver"
	depends on SOC_RISCV_ANDES_AE350
	depends on !CACHE_ENABLE || SOC_ANDES_V5_CM || NOCACHE_MEMORY
	help
	  Enable support for Andes ATFLCDC100 display driver.


if DISPLAY_ANDES_ATFLCDC100

choice ANDES_ATFLCDC100_PANEL
	prompt "Panel selection"
	default PANEL_AUA036QN01

config PANEL_AUA036QN01
	bool "Panel AUA036QN01"

config PANEL_LW500AC9601
	bool "Panel LW500AC9601"

config PANEL_AUA070VW04
	bool "Panel AUA070VW04"

endchoice

choice ANDES_RGB_FORMAT
	prompt "Andes RGB format selection"
	default ANDES_RGB_565

config ANDES_RGB_565
	bool "Andes RGB565 format"

config ANDES_RGB_888
	bool "Andes RGB888 format"

endchoice
endif # DISPLAY_ANDES_ATFLCDC100
```

## drivers/ethernet/Kconfig.andes_atfmac100
```kconfig
# Kconfig Andes ATCSPI200 SPI configuration options
#
# Copyright (c) 2019 Andes Technology Corporation.
#
# SPDX-License-Identifier: Apache-2.0
#
menuconfig ETH_ANDES_ATFMAC100
	bool "Andes ATFMAC100 ETH driver"
	depends on SOC_RISCV_ANDES_AE350
	depends on !CACHE_ENABLE || SOC_ANDES_V5_CM || NOCACHE_MEMORY
	help	
	  Enable driver for Andes ATFMAC100 ETH controller

config ANDES_ATFMAC100_TX_POLLING_MODE
	bool
	default y if ETH_ANDES_ATFMAC100

config SHELL_BACKEND_SERIAL_INTERRUPT_DRIVEN
	bool
	default n if ETH_ANDES_ATFMAC100

config ENTROPY_GENERATOR
	bool
	default y if ETH_ANDES_ATFMAC100

config TEST_RANDOM_GENERATOR
	bool
	default y if ETH_ANDES_ATFMAC100

config MAIN_STACK_SIZE
	int
	default 4096 if ETH_ANDES_ATFMAC100

config NET_TX_STACK_SIZE
	int
	default 8192 if ETH_ANDES_ATFMAC100

config NET_RX_STACK_SIZE
	int
	default 8192 if ETH_ANDES_ATFMAC100

config SYSTEM_WORKQUEUE_STACK_SIZE
	int
	default 4096 if ETH_ANDES_ATFMAC100

config HEAP_MEM_POOL_SIZE
	int
	default 16384 if ETH_ANDES_ATFMAC100

config NET_MAX_CONTEXTS
	int
	default 20 if ETH_ANDES_ATFMAC100

config NET_DHCPV4_INITIAL_DELAY_MAX
	int
	default 10 if ETH_ANDES_ATFMAC100

config NET_BUF_DATA_SIZE
	int
	default 2048 if ETH_ANDES_ATFMAC100

config NET_PKT_RX_COUNT
	int
	default 30 if ETH_ANDES_ATFMAC100

config NET_PKT_TX_COUNT
	int
	default 30 if ETH_ANDES_ATFMAC100

config NET_ARP_TABLE_SIZE
	int
	default 20 if ETH_ANDES_ATFMAC100

config ZTEST_STACKSIZE
	int
	default 4096 if ETH_ANDES_ATFMAC100
```

## drivers/gpio/Kconfig.andes_atcgpio100
```kconfig
# Kconfig Andes ATCGPIO100 configuration option
#
# Copyright (c) 2019 Andes Technology Corporation.
#
# SPDX-License-Identifier: Apache-2.0
#

menuconfig GPIO_ANDES_ATCGPIO100
	bool "Andes ATCGPIO100 GPIO driver"
	depends on SOC_SERIES_RISCV_ANDES_V5
	select HAS_DTS_GPIO
	help
	  Enable driver for the Andes ATCGPIO100 GPIO controller.

	  Says n if not sure.
```

## drivers/spi/Kconfig.andes_atcspi200
```kconfig
# Kconfig Andes ATCSPI200 SPI configuration options
#
# Copyright (c) 2019 Andes Technology Corporation.
#
# SPDX-License-Identifier: Apache-2.0
#

menuconfig SPI_ANDES_ATCSPI200
	bool "Andes ATCSPI200 SPI driver"
	depends on SOC_SERIES_RISCV_ANDES_V5
	help
	  Enable driver for Andes ATCSPI200 SPI controller

if SPI_ANDES_ATCSPI200

config ANDES_ATCSPI200_SPI_0_ROM
	bool "SPI 0 is used to access SPI Flash ROM"
	help
	  If enabled, SPI 0 is reserved for accessing the SPI flash ROM and a
	  driver interface won't be instantiated for SPI 0. This option is used
	  in XIP mode.

	  Cannot disable this option in XIP mode on Andes AE250/AE350 platforms.
	  In XIP mode, The SPI flash ROM is where program stored, so the
	  instruction fetch will use SPI 0 to access ROM. If this driver
	  initializes the interface for peripheral control, CPU may get
	  exception on instruction fetch.

endif # SPI_ANDES_ATCSPI200
```

## dts/bindings/display/andestech,atflcdc100.yaml
```yaml
#
# Copyright (c) 2019, NXP
#
# SPDX-License-Identifier: Apache-2.0
#

description:
    This binding gives a base representation of Andes ATFLCD100 controller

compatible: "andestech,atflcdc100"

include: base.yaml

properties:

    reg:
      required: true

    interrupts:
      required: true

    label:
      required: true

    clock-frequency:
      type: int
      required: true
```

## dts/bindings/ethernet/andestech,atfmac100.yaml
```yaml
#
# Copyright (c) 2019, Andes Technology Corporation.
#
# SPDX-License-Identifier: Apache-2.0
#

description:
    This is a representation of AndesTech atfmac100 ethernet node

compatible: "andestech,atfmac100"

include: ethernet.yaml

properties:

    reg:
      required: true

    label:
      required: true

    interrupts:
      required: true
```

## dts/bindings/gpio/andestech,atcgpio100.yaml
```yaml
#
# Copyright (c) 2019, Andes Technology Corporation.
#
# SPDX-License-Identifier: Apache-2.0
#

description:
    This is a representation of AndesTech atcgpio100 GPIO node

compatible: "andestech,atcgpio100"

include: [gpio-controller.yaml, base.yaml]

properties:

    reg:
      required: true

    label:
      required: true

    interrupts:
      required: true

    "#gpio-cells":
      const: 2

gpio-cells:
  - pin
  - flags
```

## dts/bindings/spi/andestech.atcspi200.yaml
```yaml
#
# Copyright (c) 2019, Andes Technology Corporation.
#
# SPDX-License-Identifier: Apache-2.0
#

description:
    This binding gives a representation of Andes ATCSPI200 SPI controller

compatible: "andestech,atcspi200"

include: spi-controller.yaml

properties:

    reg:
      required: true

    num-cs:
      type: int
      required: false
```

## dts/bindings/timer/andestech,atcpit100.yaml
```yaml
#
# Copyright (c) 2019, Andes Technology Corporation.
#
# SPDX-License-Identifier: Apache-2.0
#

description:
    This is a representation of the Andes Technology atcpit100 PIT nodes

compatible: "andestech,atcpit100"

include: base.yaml

properties:

    reg:
      required: true

    label:
      required: true

    interrupts:
      required: true

    clock-frequency:
      type: int
      description: channel clock source
      required: true
```

## soc/riscv/riscv-privilege/andes_v5/Kconfig.defconfig.ae250
```kconfig
# SPDX-License-Identifier: Apache-2.0

if SOC_RISCV_ANDES_AE250

config SOC
	string
	default "ae250"

config MAIN_STACK_SIZE
	int
	default 1536

config TEST_EXTRA_STACKSIZE
	int
	default 1024

config SYS_CLOCK_TICKS_PER_SEC
	default 10000 if TICKLESS_KERNEL
	default 100

endif # SOC_RISCV_ANDES_AE250
```

## soc/riscv/riscv-privilege/andes_v5/Kconfig.defconfig.ae350
```kconfig
# Copyright (c) 2021 Andes Technology Corporation
# SPDX-License-Identifier: Apache-2.0

if SOC_RISCV_ANDES_AE350

config SOC
	string
	default "ae350"

config MAIN_STACK_SIZE
	int
	default 2048

config IDLE_STACK_SIZE
	int
	default 1536

config TEST_EXTRA_STACKSIZE
	int
	default 1024

config SYS_CLOCK_TICKS_PER_SEC
	default 10000 if (TICKLESS_KERNEL && CACHE_ENABLE)
	default 100

endif # SOC_RISCV_ANDES_AE350
```

## soc/riscv/riscv-privilege/andes_v5/Kconfig.series
```kconfig
config SOC_SERIES_RISCV_ANDES_V5
	bool "Andes V5 SoC Series Implementation"
	select RISCV
	select SOC_FAMILY_RISCV_PRIVILEGE
	help
	  Enable support for Andes V5 SoC Series
```

## soc/riscv/riscv-privilege/andes_v5/Kconfig.soc
```kconfig
# Copyright (c) 2021 Andes Technology Corporation
# SPDX-License-Identifier: Apache-2.0

choice
prompt "Andes V5 SoC Selection"
depends on SOC_SERIES_RISCV_ANDES_V5

config SOC_RISCV_ANDES_AE250
	bool "Andes AE250 SoC implementation"
	select ATOMIC_OPERATIONS_BUILTIN
	imply ANDES_ATCSPI200_SPI_0_ROM if (XIP && SPI_ANDES_ATCSPI200)

config SOC_RISCV_ANDES_AE350
	bool "Andes AE350 SoC implementation"
	select ATOMIC_OPERATIONS_BUILTIN
	imply ANDES_ATCSPI200_SPI_0_ROM if (XIP && SPI_ANDES_ATCSPI200)
	imply SOC_ANDES_V5_PLIC_SW if (SMP || MP_NUM_CPUS > 1)
	select CACHE_ENABLE if SMP

endchoice

if SOC_SERIES_RISCV_ANDES_V5

choice
prompt "CPU Architecture of SoC"
depends on SOC_SERIES_RISCV_ANDES_V5

config RISCV_RV32
	bool "RISCV32 CPU Architecture"

config RISCV_RV64
	bool "RISCV64 CPU Architecture"
	select 64BIT

endchoice

choice
prompt "Andes V5 FPU options"
default NO_FPU

config NO_FPU
	bool "No FPU"

config SINGLE_PRECISION_FPU
	bool "Single presion FPU"
	select CPU_HAS_FPU

config DOUBLE_PRECISION_FPU
	bool "Double presion FPU"
	select CPU_HAS_FPU_DOUBLE_PRECISION

endchoice

config CACHE_ENABLE
	bool "Enable cache"
	default n

config SOC_ANDES_V5_L2_CACHE
	bool "Enable Andes V5 L2 cache"
	depends on CACHE_ENABLE
	default y

config SOC_ANDES_V5_HWDSP
	bool "Enable Andes V5 Hardware DSP"
	select RISCV_SOC_CONTEXT_SAVE

config SOC_ANDES_V5_PFT
	bool "Enable Andes V5 performance throttling"
	default y
	select RISCV_SOC_CONTEXT_SAVE

if SOC_RISCV_ANDES_AE350

config SOC_ANDES_V5_PMA
	bool "Enable Andes V5 Physical Memory Attribute (PMA)"
	select ARCH_HAS_NOCACHE_MEMORY_SUPPORT
	select MPU_REQUIRES_POWER_OF_TWO_ALIGNMENT

config SOC_ANDES_V5_PMA_REGION_MIN_ALIGN_AND_SIZE
	int
	default 4096
	help
	  Minimum size (and alignment) of an PMA region. Use this symbol
	  to guarantee minimum size and alignment of PMA regions.

config SOC_ANDES_V5_PLIC_SW
	bool "Enable Andes V5 PLIC SW as IPI controller"
	select SCHED_IPI_SUPPORTED
	default y if SMP || (MP_NUM_CPUS > 1)

config SOC_ANDES_V5_CM
	bool "Support Andes V5 Coherence Manager (CM) to handle cache-coherency of DMA"
	depends on CACHE_ENABLE
	help
		Support Andes V5 Coherence Manager (CM) and I/O Coherence Port (IOCP)
		to handle DMA cache-coherency by HW of devices connected to IOCP.

endif # SOC_RISCV_ANDES_AE350

endif # SOC_SERIES_RISCV_ANDES_V5
```

## tests/drivers/i2c/i2c_master/testcase.yaml
```yaml
common:
    depends_on: i2c
    tags: drivers i2c
    harness: sensor
    filter: dt_alias_exists("i2c-0") or
            dt_alias_exists("i2c-1") or
            dt_alias_exists("i2c-2")
    platform_allow: adp_xc7k_ae250 adp_xc7k_ae350 vcu118_ae350 adp_corvette_f1

tests:
  drivers.i2c_master_ctrl_eeprom_on_board:
    extra_args: CTRL_SIMU_EEPROM=0

  drivers.i2c_master_ctrl_simulated_eeprom:
    extra_args: CTRL_SIMU_EEPROM=1
```

## tests/drivers/i2c/i2c_slave/testcase.yaml
```yaml
tests:
  drivers.i2c_slave_simulate_eeprom:
    depends_on: i2c
    tags: drivers i2c
    harness: ztest
    harness_config:
      fixture: i2c_bus_short
    platform_allow: adp_xc7k_ae250 adp_xc7k_ae350 vcu118_ae350 adp_corvette_f1
```
