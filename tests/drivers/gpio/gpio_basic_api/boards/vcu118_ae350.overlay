
/*
 * Copyright (c) 2020 Andes Technology Corporation
 *
 * SPDX-License-Identifier: Apache-2.0
 */

/ {
	resources {
		compatible = "test,gpio_basic_api";
		status = "okay";
		out-gpios = <&gpio0 17 GPIO_ACTIVE_HIGH>;
		in-gpios = <&gpio0 18 GPIO_ACTIVE_HIGH>;
	};
};
